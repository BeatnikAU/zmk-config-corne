## config/west.yml
```yaml
manifest:
  remotes:
    - name: zmkfirmware
      url-base: https://github.com/zmkfirmware
#    - name: beatnik
#      url-base: https://github.com/beatnikau
  projects:
    - name: zmk
      remote: zmkfirmware
      revision: v0.3
      import: app/west.yml
#    - name: nice-view-mod
#      remote: beatnik
#      revision: main
  self:
    path: config
```
